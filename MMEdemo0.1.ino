#include <gamma.h>
#include <RGBmatrixPanel.h>
//#define CLK  8   // USE THIS ON ADAFRUIT METRO M0, etc.
//#define CLK A4 // USE THIS ON METRO M4 (not M0)
#define CLK 11 // USE THIS ON ARDUINO MEGA
#define OE   9
#define LAT 10
#define A   A0
#define B   A1
#define C   A2
#define D   A3

// Define some speeds to play with in ms
#define DSLOW 120
#define DMEDIUM 80
#define DRAPID 65
#define DFAST 40
#define DQUICK 30
#define DULTRA 21
#define DPICO 5
#define DNANO 2

// mega ready 
RGBmatrixPanel matrix(A, B, C, D, CLK, LAT, OE, false, 64);

void setup() {
  Serial.begin(115200); 
  matrix.begin();
  // draw some text!
  matrix.setTextSize(1);     // size 1 == 8 pixels high
  matrix.setTextWrap(false); // Don't wrap at end of line - will do ourselves

}
// Generated by   : ImageConverter 565 Online
// Generated from : mmelogo2.jpg
// Time generated : Sun, 13 Feb 22 04:30:39 +0100  (Server timezone: CET)
// Image Size     : 58x19 pixels
// Memory usage   : 2204 bytes


#if defined(__AVR__)
    #include <avr/pgmspace.h>
#elif defined(__PIC32MX__)
    #define PROGMEM
#elif defined(__arm__)
    #define PROGMEM
#endif

const unsigned short surface[1102] PROGMEM={
0x20E3, 0x2903, 0x20C3, 0x2104, 0x20E3, 0x20E3, 0x20C3, 0x28E4, 0x20E3, 0x20C3, 0x2924, 0x20E3, 0x20C3, 0x2904, 0x20E3, 0x2103,   // 0x0010 (16) pixels
0x20E3, 0x20C3, 0x20E3, 0x20E3, 0x20E3, 0x20E3, 0x20E3, 0x2903, 0x2103, 0x20E3, 0x2903, 0x20C3, 0x20E3, 0x2103, 0x20E3, 0x2103,   // 0x0020 (32) pixels
0x2904, 0x20E3, 0x20C3, 0x2103, 0x20E3, 0x2103, 0x20E3, 0x8C30, 0x9CD2, 0x9CD2, 0x9CD3, 0x9CD2, 0x9CD2, 0x9CB2, 0x9CD3, 0x94B2,   // 0x0030 (48) pixels
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0x736E, 0x736E, 0x736E, 0x736E, 0x736D, 0x736D, 0x73AE, 0x738D, 0x6B4D, 0x736E, 0x528A, 0x20E3, 0x2903, 0x2903, 0x2903, 0x2903,   // 0x0440 (1088) pixels
};

int between=1,mcount=0;
int GX=64-58,GY=32-19; // per screen difference from image size in pixels, which is 58,19  

#define ARRAYSIZE 10

String str[ARRAYSIZE] = { "] mme [", 
                          "cleanmgr /sagerun:1", 
                          "net stop spooler; net start spooler",
                          "osql -s server checkdbcc",
                          "tasklist | findstr /i %proc%",
                          "icacls . /grant Records1:(d,wdac)",
                          "/usr/sbin/fdisk -l"
                        };
                        
String str2[ARRAYSIZE] = { "powershell -exec bypass -file a.ps1", 
                          "ufw allow ssh", 
                          "net view",
                          "ssh -l amplex ss.gpo.tools",
                          "lsusb",
                          "Serial.println(randName);",
                          "c:\\windows\\system32\\windowspowershell\\v1.0\\powershell.exe"
                        };

void loop() {
  //quick_test();
  MME_movement();
  MME_movement2();
  MME_movement3();

} 

void MME_movement3() {
  int x,y,z,times=0;
  bool xup,yup,zup=false;
  
  matrix.setTextSize(.5);     // size 1 == 8 pixels high
  matrix.setTextWrap(false); // Don't wrap at end of line - will do ourselves

  for (times=0; times<between; times++) {
    for (int x=0; x<=GX; x++) {
      matrix.drawRGBBitmap(x, 0, (const uint16_t *)surface, 58, 19);
      matrix.setCursor(1+x/2, 22+x/5); 
      matrix.setTextColor(matrix.Color333(x,x,x));
      matrix.print("[ MME ]");
      delay(DFAST);
    
      matrix.setCursor(1+x/2+.1, 22+x/5); 
      matrix.setTextColor(matrix.Color333(x-4,x-4,x-10));
      matrix.print("[ MME ]");
      delay(DQUICK);
        
      matrix.setCursor(1+x/2, 22+x/5); 
      matrix.setTextColor(matrix.Color333(0,0,0));
      matrix.print("[ MME ]");
      delay(DNANO);
    
      
    }
    for (int x=GX; x>=0; x--) {
      matrix.drawRGBBitmap(x, 0, (const uint16_t *)surface, 58, 19);
      matrix.drawRGBBitmap(x, 0, (const uint16_t *)surface, 58, 19);
      matrix.setCursor(1+x*x, 22+x/5); 
      matrix.setTextColor(matrix.Color333(x,x,x));
      matrix.print(str[x]);
      delay(DFAST);
      matrix.setCursor(1+x*x, 22+x/5); 
      matrix.setTextColor(matrix.Color333(0,0,0));
      matrix.print(str[x]);
      delay(DNANO);
    }
  }
  for (int x=GX; x>=0; x--) {
      matrix.drawRGBBitmap(x, 0, (const uint16_t *)surface, 58, 19);
      matrix.drawRGBBitmap(x, 0, (const uint16_t *)surface, 58, 19);
      matrix.setCursor(1+x*x, 22+x/5); 
      matrix.setTextColor(matrix.Color333(x,x,x));
      matrix.print(str2[x]);
      delay(DFAST);
      matrix.setCursor(1+x*x, 22+x/5); 
      matrix.setTextColor(matrix.Color333(0,0,0));
      matrix.print(str2[x]);
      delay(DNANO);
  }
}

void MME_movement2() {
  int x,y,z,times=0;
  bool xup,yup,zup=false;
  
  matrix.setTextSize(.5);     // size 1 == 8 pixels high
  matrix.setTextWrap(false); // Don't wrap at end of line - will do ourselves

  for (times=0; times<between; times++) {
    for (int x=0; x<=GX; x++) {
      matrix.drawRGBBitmap(x, 0, (const uint16_t *)surface, 58, 19);
      matrix.setCursor(1+x/2, 22+x/5); 
      matrix.setTextColor(matrix.Color333(x,x,x));
      matrix.print("[ MME ]");
      delay(DFAST);
      matrix.setCursor(1+x/2, 22+x/5); 
      matrix.setTextColor(matrix.Color333(0,0,0));
      matrix.print("[ MME ]");
      delay(DFAST);
    }
    for (int x=GX; x>=0; x--) {
      matrix.drawRGBBitmap(x, 0, (const uint16_t *)surface, 58, 19);
      matrix.drawRGBBitmap(x, 0, (const uint16_t *)surface, 58, 19);
      matrix.setCursor(1+x*x, 18+x/6); 
      matrix.setTextColor(matrix.Color333(x,x,x));
      matrix.print(" [ MME ] ");
      delay(DFAST);
      matrix.setCursor(1+x*x, 18+x/6); 
      matrix.setTextColor(matrix.Color333(0,0,0));
      matrix.print(" [ MME ] ");
      delay(DFAST);
    }
  }

  
}

void MME_movement() {
  int x,y,z,times=0;
  bool xup,yup,zup=false;
  
  for (times=0; times<between; times++) {
    for (int x=0; x<=GX; x++) {
      matrix.drawRGBBitmap(x, 0, (const uint16_t *)surface, 58, 19);
    }
    for (int y=0; y<=GY; y++) {
      matrix.drawRGBBitmap(GX, y, (const uint16_t *)surface, 58, 19);
    }
    
    for (int x=GX; x>=0; x--) {
      matrix.drawRGBBitmap(x, GY, (const uint16_t *)surface, 58, 19);
    }
    for (int y=GY; y>=0; y--) {
      matrix.drawRGBBitmap(0, y, (const uint16_t *)surface, 58, 19);
    }
    for (int x=0; x<=GX; x++) {
      matrix.drawRGBBitmap(x, 0, (const uint16_t *)surface, 58, 19);
    }
    
    turnaround();
    
    for (int x=GX; x>=0; x--) {
      matrix.drawRGBBitmap(x, 0, (const uint16_t *)surface, 58, 19);
    }
    for (int y=0; y<=GY; y++) {
      matrix.drawRGBBitmap(0, y, (const uint16_t *)surface, 58, 19);
    }
    for (int x=0; x<=GX; x++) {
      matrix.drawRGBBitmap(x, GY, (const uint16_t *)surface, 58, 19);
    }
    for (int y=GY; y>=0; y--) {
      matrix.drawRGBBitmap(GX, y, (const uint16_t *)surface, 58, 19);
    }  
    for (int x=GX; x>=0; x--) {
      matrix.drawRGBBitmap(x, 0, (const uint16_t *)surface, 58, 19);
    }
    
    switch (mcount) {
      case 0:
        turnaround2();
        break;
      case 1:
        turnaround3();
        break;
    }
    if (mcount>1) mcount=0; else mcount+=1;
    
    
    
  }
}

void resetscreen() {
  // fill the screen with 'black'
  matrix.fillScreen(matrix.Color333(0, 0, 0));
}

void turnaround() {
  int count=0;
  int x=GX,y=0;
  bool yup,xup=true;
  
  while (count<24) {
    if (xup) { x++; } else { x--; }
    if (yup) { y++; } else { y--; }
    if (x==12) { xup=false; }
    if (y==12) { yup=false; }
    if (x==0) { xup=true; }
    if (y==0) { yup=true; }
    matrix.drawRGBBitmap(x, y, (const uint16_t *)surface, 58, 19);
    count+=1;
  }
}

void turnaround2() {
  int x=0,y=0;
  int count=0;
  bool yup=true,xup=true;
  
  while (count<=GY*2) { // (the largest difference *2 to come back into place)
    if (xup) { x++; } else { x--; }
    if (yup) { y++; } else { y--; }
    if (x==GX) { xup=false; }
    if (y==GY) { yup=false; }
    if (x==0) { xup=true; }
    if (y==0) { yup=true; }
    matrix.drawRGBBitmap(x, y, (const uint16_t *)surface, 58, 19);
    count+=1;
  }
}

void turnaround3() {
  int x=0,y=0;
  int count=0;
  bool yup=true,xup=false;
  
  while (count<=GY) {
    if (xup) { x++; } else { x--; }
    if (yup) { y++; } else { y--; }
    if (x==GX) { xup=false; }
    if (y==GY) { yup=false; }
    if (x==0) { xup=true; }
    if (y==0) { yup=true; }
    matrix.drawRGBBitmap(x, y, (const uint16_t *)surface, 58, 19);
    count+=1;
  }
}

void quick_test(){
  int test=0;
  for (test=0; test<10; test++) {
    matrix.setCursor(1, 8); 
    matrix.setTextColor(matrix.Color333(10+test,10+test,10+test)); 
    matrix.print("-");
    delay(100);
  }
}

// Input a value 0 to 24 to get a color value.
// The colours are a transition r - g - b - back to r.
uint16_t Wheel(byte WheelPos) {
  if(WheelPos < 8) {
   return matrix.Color333(7 - WheelPos, WheelPos, 0);
  } else if(WheelPos < 16) {
   WheelPos -= 8;
   return matrix.Color333(0, 7-WheelPos, WheelPos);
  } else {
   WheelPos -= 16;
   return matrix.Color333(WheelPos, 0, 7 - WheelPos);
  }
}
